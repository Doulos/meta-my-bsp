## conf/layer.conf
```bitbake
# We have a conf and classes directory, add to BBPATH
BBPATH .= ":${LAYERDIR}"

# We have recipes-* directories, add to BBFILES
BBFILES += "${LAYERDIR}/recipes-*/*/*.bb \
            ${LAYERDIR}/recipes-*/*/*.bbappend"

BBFILE_COLLECTIONS += "meta-my-bsp"
BBFILE_PATTERN_meta-my-bsp = "^${LAYERDIR}/"
BBFILE_PRIORITY_meta-my-bsp = "9"

LAYERDEPENDS_meta-my-bsp = "core"
LAYERSERIES_COMPAT_meta-my-bsp = "kirkstone"

# TODO: leaving this here for further testing. 
# Attempted to add dynamic files to hide append recipes when building for QEMU.
# Our dynamic append recipes get parsed (when meta-rtos-industrial layer is enabled),
# but the variables are ignored (e.g not possible to add KERNEL_FEATURES).
# Using BBMASK in QEMU local.conf file instead for now.
# FIXME: the "dynamic-layers" directories and files don't exist.   
#BBFILES_DYNAMIC += "\
#   meta-rtos-industrial:${LAYERDIR}/dynamic-layers/meta-freescale/recipes-*/*/*.bbappend \
#   "
```
